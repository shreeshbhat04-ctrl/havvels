## co-ex_boiler/NodeA_s3/sdkconfig.defaults
```kconfig
# NodeA_s3 — ESP32-S3: Wi-Fi AP + BLE Central (NimBLE)

# Enable Bluetooth
CONFIG_BT_ENABLED=y

# Use NimBLE (not Bluedroid)
CONFIG_BT_NIMBLE_ENABLED=y
CONFIG_BT_NIMBLE_ROLE_CENTRAL=y
CONFIG_BT_NIMBLE_ROLE_PERIPHERAL=n
CONFIG_BT_NIMBLE_ROLE_OBSERVER=y
CONFIG_BT_NIMBLE_ROLE_BROADCASTER=n

# Wi-Fi
CONFIG_ESP_WIFI_ENABLED=y

# Software coexistence (Wi-Fi + BLE)
CONFIG_ESP_COEX_SW_COEXIST_ENABLE=y

# Partition table
CONFIG_PARTITION_TABLE_SINGLE_APP=y
```

## co-ex_boiler/NodeB_classic/sdkconfig.defaults
```kconfig
# NodeB_classic — ESP32: Wi-Fi STA + BLE Peripheral (NimBLE)

# Enable Bluetooth
CONFIG_BT_ENABLED=y

# Use NimBLE
CONFIG_BT_NIMBLE_ENABLED=y
CONFIG_BT_NIMBLE_ROLE_CENTRAL=n
CONFIG_BT_NIMBLE_ROLE_PERIPHERAL=y
CONFIG_BT_NIMBLE_ROLE_OBSERVER=n
CONFIG_BT_NIMBLE_ROLE_BROADCASTER=y

# Wi-Fi
CONFIG_ESP_WIFI_ENABLED=y

# Software coexistence (Wi-Fi + BLE)
CONFIG_ESP_COEX_SW_COEXIST_ENABLE=y

# Partition table
CONFIG_PARTITION_TABLE_SINGLE_APP=y
```

## co-ex_boiler/NodeC_h2/sdkconfig.defaults
```kconfig
# NodeC_h2 — ESP32-H2: Zigbee End Device + BLE Peripheral (NimBLE)

# Enable Bluetooth
CONFIG_BT_ENABLED=y

# Use NimBLE
CONFIG_BT_NIMBLE_ENABLED=y
CONFIG_BT_NIMBLE_ROLE_CENTRAL=n
CONFIG_BT_NIMBLE_ROLE_PERIPHERAL=y
CONFIG_BT_NIMBLE_ROLE_OBSERVER=n
CONFIG_BT_NIMBLE_ROLE_BROADCASTER=y

# Zigbee End Device
CONFIG_ZB_ENABLED=y
CONFIG_ZB_ED_ROLE=y

# Custom partition table for Zigbee storage
CONFIG_PARTITION_TABLE_CUSTOM=y
CONFIG_PARTITION_TABLE_CUSTOM_FILENAME="partition.csv"

# Software coexistence (BLE + 802.15.4)
CONFIG_ESP_COEX_SW_COEXIST_ENABLE=y
# Enable Bluetooth (NimBLE)
CONFIG_BT_ENABLED=y
CONFIG_BT_NIMBLE_ENABLED=y

# Enable 802.15.4 (Zigbee)
CONFIG_IEEE802154_ENABLED=y

# Enable coexistence — time-slices the single radio between Zigbee and BLE
CONFIG_ESP_COEX_SW_COEXIST_ENABLE=y
```

## sdkconfig.defaults
```kconfig
# Haavvvels — Shared sdkconfig defaults (all targets)
# Enable software coexistence for Wi-Fi+BLE / Zigbee+BLE time-sharing
CONFIG_ESP_COEX_SW_COEXIST_ENABLE=y
```

## sdkconfig.defaults.esp32
```kconfig
# Haavvvels — ESP32 Classic specific defaults
# Enable software coexistence (Wi-Fi + BLE time-sharing)
CONFIG_ESP_COEX_SW_COEXIST_ENABLE=y
# BLE requires Bluetooth enabled
CONFIG_BT_ENABLED=y
CONFIG_BT_BLE_ENABLED=y
```

## sdkconfig.defaults.esp32h2
```kconfig
# Haavvvels — ESP32-H2 specific defaults
# Enable software coexistence (Zigbee + BLE time-sharing)
CONFIG_ESP_COEX_SW_COEXIST_ENABLE=y
```

## sdkconfig.defaults.esp32s3
```kconfig
# Haavvvels — ESP32-S3 specific defaults
# Enable software coexistence (Wi-Fi + BLE time-sharing)
CONFIG_ESP_COEX_SW_COEXIST_ENABLE=y
# BLE required for intercom mode (BLE scanner)
CONFIG_BT_ENABLED=y
CONFIG_BT_BLE_ENABLED=y
CONFIG_BT_BLUEDROID_ENABLED=y
# Wi-Fi + BLE binary exceeds 1MB — use large partition table
CONFIG_PARTITION_TABLE_SINGLE_APP_LARGE=y
```
